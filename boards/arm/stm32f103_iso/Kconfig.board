## boards/arm/stm32f103_iso/Kconfig.board
```kconfig
# STM32F103RCT6 Mini board configuration

# Copyright (c) 2020 WuhanStudio
# SPDX-License-Identifier: Apache-2.0

config BOARD_STM32F103_ISO
	bool "STM32F103ZET6 ISO Board"
	depends on SOC_STM32F103XE
```

## boards/arm/stm32f103_iso/Kconfig.defconfig
```kconfig
# STM32F103ZET6 ISO board configuration

# Copyright (c) 2020 WuhanStudio
# SPDX-License-Identifier: Apache-2.0

if BOARD_STM32F103_ISO

config BOARD
	default "stm32f103_iso"

endif # BOARD_STM32F103_iso
```

## boards/arm/stm32f103_iso/stm32f103_iso_defconfig
```kconfig
# SPDX-License-Identifier: Apache-2.0

CONFIG_SOC_SERIES_STM32F1X=y
CONFIG_SOC_STM32F103XE=y

# enable uart driver
CONFIG_SERIAL=y
# enable console
CONFIG_CONSOLE=y
CONFIG_UART_CONSOLE=y

# enable GPIO
CONFIG_GPIO=y

# enable clocks
CONFIG_CLOCK_CONTROL=y

# enable pin controller
CONFIG_PINCTRL=y

# enable I2C controller & eeprom
CONFIG_I2C=y
CONFIG_EEPROM=y

# enable SPI controller & flash
CONFIG_SPI=y
CONFIG_FLASH=y

# enable WATCHDOG
#CONFIG_WATCHDOG=y

# enable CAN
CONFIG_CAN=y

# enable ADC
CONFIG_ADC=y

# enable ADC
CONFIG_DAC=y
```

## boards/arm/stm32f103_zet6/Kconfig.board
```kconfig
# STM32F103RCT6 Mini board configuration

# Copyright (c) 2020 WuhanStudio
# SPDX-License-Identifier: Apache-2.0

config BOARD_STM32F103_ZET6
	bool "STM32F103ZET6 Board"
	depends on SOC_STM32F103XE
```

## boards/arm/stm32f103_zet6/Kconfig.defconfig
```kconfig
# STM32F103RCT6 Mini board configuration

# Copyright (c) 2020 WuhanStudio
# SPDX-License-Identifier: Apache-2.0

if BOARD_STM32F103_ZET6

config BOARD
	default "stm32f103_zet6"

endif # BOARD_STM32F103_ZET6
```
